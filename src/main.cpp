#include <sumastaConfig.h>

#include <Wire.h>
#include "PxMatrix.h"

#include "Ticker.h"
Ticker display_ticker;
#define P_LAT 16
#define P_A 5
#define P_B 4
#define P_C 15
#define P_D 12
#define P_E 0
#define P_OE 2


#define MATRIX_WIDTH 64
#define MATRIX_HEIGHT 32

//#include "effects.h"
//Effects effects;

#define matrix_width 64
#define matrix_height 32

// This is how many color levels the display shows - the more the slower the update
//#define PxMATRIX_COLOR_DEPTH 4

// Defines the speed of the SPI bus (reducing this may help if you experience noisy images)
//#define PxMATRIX_SPI_FREQUENCY 20000000

// Creates a second buffer for backround drawing (doubles the required RAM)

//#define PxMATRIX_double_buffer true


// This defines the 'on' time of the display is us. The larger this number,
// the brighter the display. If too large the ESP will crash
uint8_t display_draw_time=70; //30-70 is usually fine

//PxMATRIX display(32,16,P_LAT, P_OE,P_A,P_B,P_C);
PxMATRIX display(64,32,P_LAT, P_OE,P_A,P_B,P_C,P_D);
//PxMATRIX display(64,64,P_LAT, P_OE,P_A,P_B,P_C,P_D,P_E);

// Some standard colors
uint16_t myRED = display.color565(255, 0, 0);
uint16_t myGREEN = display.color565(0, 255, 0);
uint16_t myBLUE = display.color565(0, 0, 255);
uint16_t myWHITE = display.color565(255, 255, 255);
uint16_t myYELLOW = display.color565(255, 255, 0);
uint16_t myCYAN = display.color565(0, 255, 255);
uint16_t myMAGENTA = display.color565(255, 0, 255);
uint16_t myBLACK = display.color565(0, 0, 0);

uint16_t myCOLORS[8]={myRED,myGREEN,myBLUE,myWHITE,myYELLOW,myCYAN,myMAGENTA,myBLACK};

uint8_t static weather_icons[]={0x00,0x00,0x00,0x00,0x00,0x00,0x00,0x20,0x00,0x00,0x00,0x00,0x00,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0x00
  ,0x00,0x00,0x00,0x00,0x00,0x00,0x00,0x00,0xff,0xe0,0x00,0x00,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0x00
  ,0x00,0x00,0x00,0x00,0xff,0xe0,0x00,0x00,0x00,0x00,0x00,0x00,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0x00
  ,0x00,0x20,0x00,0x00,0x00,0x00,0xff,0xe0,0xff,0xe0,0xff,0xe0,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0x00
  ,0x00,0x00,0xff,0xe0,0x00,0x00,0xff,0xe0,0xff,0xe0,0xff,0xe0,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0x00
  ,0x00,0x00,0x00,0x00,0x00,0x00,0xff,0xe0,0xff,0xe0,0xff,0xe0,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0x00
  ,0x00,0x00,0x00,0x00,0xff,0xe0,0x00,0x00,0x00,0x00,0x00,0x00,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0x00
  ,0x00,0x00,0x00,0x00,0x00,0x00,0x00,0x00,0xff,0xe0,0x00,0x00,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0x00
  ,0x00,0x00,0x00,0x00,0x00,0x00,0x00,0x00,0x00,0x00,0x00,0x00,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0x00
  ,0x00,0x00,0x00,0x00,0x00,0x00,0x00,0x00,0x00,0x00,0x00,0x00,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0x00
};


void display_updater()
{
  display.display(display_draw_time);
}


void display_update_enable(bool is_enable)
{

#ifdef ESP8266
  if (is_enable)
    display_ticker.attach(0.004, display_updater);
  else
    display_ticker.detach();
#endif

#ifdef ESP32
  if (is_enable)
  {
    timer = timerBegin(0, 80, true);
    timerAttachInterrupt(timer, &display_updater, true);
    timerAlarmWrite(timer, 4000, true);
    timerAlarmEnable(timer);
  }
  else
  {
    timerDetachInterrupt(timer);
    timerAlarmDisable(timer);
  }
#endif
}

#include <ESP8266WiFi.h>
#include <ESP8266WiFiMulti.h>

#include <ESP8266HTTPClient.h>

#define USE_SERIAL Serial

ESP8266WiFiMulti WiFiMulti;

int aveUplink = 0;
int aveDownlink = 0;
float aveLat = 0;

void setup() {

    USE_SERIAL.begin(9600);
    USE_SERIAL.println();
    USE_SERIAL.println();
    USE_SERIAL.println();

    for (uint8_t t = 4; t > 0; t--) {
        USE_SERIAL.printf("[SETUP] WAIT %d...\n", t);
        USE_SERIAL.flush();
        delay(1000);
    }

    WiFi.mode(WIFI_STA);
    WiFiMulti.addAP("WiFi 755", "printedcircuitboard");

  // Define your display layout here, e.g. 1/8 step, and optional SPI pins begin(row_pattern, CLK, MOSI, MISO, SS)
  display.begin(16);
  //display.begin(8, 14, 13, 12, 4);

  // Define multiplex implemention here {BINARY, STRAIGHT} (default is BINARY)
  //display.setMuxPattern(BINARY);

  // Set the multiplex pattern {LINE, ZIGZAG,ZZAGG, ZAGGIZ, WZAGZIG, VZAG, ZAGZIG} (default is LINE)
  //display.setScanPattern(LINE);

  // Rotate display
  //display.setRotate(true);

  // Flip display
  //display.setFlip(true);

  // Control the minimum color values that result in an active pixel
  //display.setColorOffset(5, 5,5);

  // Set the multiplex implemention {BINARY, STRAIGHT} (default is BINARY)
  //display.setMuxPattern(BINARY);

  // Set the color order {RRGGBB, RRBBGG, GGRRBB, GGBBRR, BBRRGG, BBGGRR} (default is RRGGBB)
  //display.setColorOrder(RRGGBB);

  // Set the time in microseconds that we pause after selecting each mux channel
  // (May help if some rows are missing / the mux chip is too slow)
  //display.setMuxDelay(0,1,0,0,0);

  // Set the number of panels that make up the display area width (default is 1)
  //display.setPanelsWidth(2);

  // Set the brightness of the panels (default is 255)
  //display.setBrightness(50);

  // Set driver chip type
  display.setDriverChip(FM6124);

  display.clearDisplay();
  display.setTextColor(myCYAN);
  display.setCursor(2,0);
  display.print("Sumasta");
  display.setTextColor(myMAGENTA);
  display.setCursor(2,8);
  display.print("Pixel");
  display_update_enable(true);

  //effects.Setup();

  delay(300);

  randomSeed(100);

    // Real speed
  aveUplink = getUplinkSpeed();
  aveDownlink = getDownlinkSpeed();
  //aveLat = getLatency();

  USE_SERIAL.println("out");

    // Dummys
    //  aveUplink = getUplink();
    //aveDownlink = getDownlink();
    aveLat = getLat();
}
union single_double{
  uint8_t two[2];
  uint16_t one;
} this_single_double;

// This draws the weather icons
void draw_weather_icon (uint8_t icon)
{
  if (icon>10)
  icon=10;
  for (int yy=0; yy<10;yy++)
  {
    for (int xx=0; xx<10;xx++)
    {
      uint16_t byte_pos=(xx+icon*10)*2+yy*220;
      this_single_double.two[1]=weather_icons[byte_pos];
      this_single_double.two[0]=weather_icons[byte_pos+1];
      display.drawPixel(1+xx,yy,this_single_double.one);
    }
  }
}

unsigned long last_draw=0;


void scroll_text(uint8_t ypos, unsigned long scroll_delay, String text, uint8_t colorR, uint8_t colorG, uint8_t colorB)
{
    uint16_t text_length = text.length();
    display.setTextWrap(false);  // we don't wrap text so it scrolls nicely
    display.setTextSize(1);
    display.setRotation(0);
    display.setTextColor(display.color565(colorR,colorG,colorB));

    //int aveUplink = getUplinkSpeed();
    //int aveDownlink = getDownlinkSpeed();
    //float aveLat = getLatency();

    // Asuming 5 pixel average character width
    for (int xpos=matrix_width; xpos>-(matrix_width+text_length*5); xpos--)
    {
        display.setTextColor(display.color565(colorR,colorG,colorB));
      display.clearDisplay();
      display.setCursor(xpos,ypos);
      display.println(text);
      
      display.setTextColor(myCYAN);
      //display.setTextSize(1);
      display.setRotation(0);
      display.setCursor(11,8);
      display.println(aveUplink);

      display.setTextColor(myYELLOW);
      display.setCursor(11,16);
      display.println(aveDownlink);

      display.setTextColor(myGREEN);
      display.setCursor(2,24);
      display.println(aveLat);

      display.setTextColor(myCYAN);
        display.setCursor(38,8);
        display.println("Mbps");

      display.setTextColor(myYELLOW);
      display.setCursor(38,16);
      display.println("Mbps");

      display.setTextColor(myGREEN);
      display.setCursor(28,24);
      display.println("ms");
      display.setCursor(43, 24);
      display.println("Lat");
 
      display.drawFastVLine(5, 8, 7, myCYAN);
      display.drawFastVLine(4, 8, 7, myCYAN);
      display.drawLine(4, 8, 2, 12, myCYAN);
      display.drawLine(4, 9, 2, 12, myCYAN);
      display.drawLine(5, 8, 7, 12, myCYAN);
      display.drawLine(5, 9, 7, 12, myCYAN);


      display.drawFastVLine(5, 16, 7, myYELLOW);
      display.drawFastVLine(4, 16, 7, myYELLOW);
      display.drawLine(4, 21, 2, 19, myYELLOW);
      display.drawLine(4, 22, 2, 19, myYELLOW);
      display.drawLine(5, 21, 7, 19, myYELLOW);
      display.drawLine(5, 22, 7, 19, myYELLOW);

  
      yield();
        delay(scroll_delay);
      // This might smooth the transition a bit if we go slow
      // display.setTextColor(display.color565(colorR/4,colorG/4,colorB/4));
      // display.setCursor(xpos-1,ypos);
      // display.println(text);
   
      delay(scroll_delay/5);
      yield();

    }
}

int getUplink() {

    return (1450 + (random(100)));
}

int getDownlink() {

    return (1450 + (random(100)));
}

float getLat() {
    float lat = (random(60) / 100.0);
    return lat += 0.5;
}

float getLatency() {
    //return 0.6;

    //float lat = (random(70) / 100.0);
    //lat += 0.4;
    String payload = "0.00";
    if ((WiFiMulti.run() == WL_CONNECTED)) {

        HTTPClient http;

        USE_SERIAL.print("[HTTP] begin...\n");
        // configure traged server and url
        http.begin("http://192.168.1.112"); //HTTP

        USE_SERIAL.print("[HTTP] GET Latency\n");
        // start connection and send HTTP header
        int httpCode = http.GET();

        // httpCode will be negative on error
        if (httpCode > 0) {
            // HTTP header has been send and Server response header has been handled
            USE_SERIAL.printf("[HTTP] GET... code: %d\n", httpCode);

            // file found at server
            if (httpCode == HTTP_CODE_OK) {
                payload = http.getString();
                USE_SERIAL.println(payload);
                USE_SERIAL.println("out1");
            }
        }
        else {
            USE_SERIAL.printf("[HTTP] GET... failed, error: %s\n", http.errorToString(httpCode).c_str());
        }
    }

    USE_SERIAL.println("out2");
    return payload.toFloat();
    
}

uint8_t icon_index=0;
long counterUpdate = millis();
void loop() {

  scroll_text(0,20,"Signify TruLiFi current PHY Speed & Latency",255,150,150);
  //scroll_text(0,20,"Real Time LiFi PHY Speed & Latency",255,150,150);

  if (millis()-counterUpdate > 30000) {

      for (int i = 0; i < matrix_width; i++) {
          display.drawFastVLine(i, 0, matrix_height, display.color565(i*4, 255-i*4, 0));
          delay(30);
      }
      for (int i = 0; i < matrix_width; i++) {
          display.drawFastVLine(i, 0, matrix_height, display.color565(0,0,0));
          delay(30);
      }
      for (int i = 0; i < matrix_height; i++) {
          display.drawFastHLine(0,i, matrix_width, display.color565(i * 4,0, 255 - i * 4));
          delay(30);
      }
      for (int i = 0; i < matrix_height; i++) {
          display.drawFastHLine(0, i, matrix_width, display.color565(0,0,0));
          delay(30);
      }
      for (int i = matrix_width; i >= 0; i--) {
          display.drawFastVLine(i, 0, matrix_height, display.color565(0,i * 4, 255 - i * 4));
          delay(30);
      }
      for (int i = matrix_width; i >= 0; i--) {
          display.drawFastVLine(i, 0, matrix_height, display.color565(0,0,0));
          delay(30);
      }


      aveDownlink = getDownlinkSpeed();
      aveUplink = getUplinkSpeed();
      //aveLat = getLatency();

            // Dummys
            /*
      aveUplink = getUplink();
    aveDownlink = getDownlink();
    */
    aveLat = getLat();

      counterUpdate = millis();
  }

}

int getUplinkSpeed() {

    int speed = 0;
    String AP_LIFI_IP = "http://192.168.1.10";

    if ((WiFiMulti.run() == WL_CONNECTED)) {

        HTTPClient http;

        USE_SERIAL.print("[HTTP] begin...\n");

        boolean gotMbps = false;

        // configure server and url
        http.begin(AP_LIFI_IP);
        //http.begin("192.168.1.12", 80, "/test.html");

        USE_SERIAL.print("[HTTP] GET...\n");
        // start connection and send HTTP header
        int httpCode = http.GET();
        if (httpCode > 0) {
            // HTTP header has been send and Server response header has been handled
            USE_SERIAL.printf("[HTTP] GET UPLINK code: %d\n", httpCode);

            // file found at server
            if (httpCode == HTTP_CODE_OK) {

                // get lenght of document (is -1 when Server sends no Content-Length header)
                int len = http.getSize();

                // create buffer for read
                uint8_t buff[128] = { 0 };

                // get tcp stream
                WiFiClient* stream = http.getStreamPtr();

                // read all data from server
                while (http.connected() && (len > 0 || len == -1)) {
                    // get available data size
                    size_t size = stream->available();

                    if (size) {
                        // read up to 128 byte
                        int c = stream->readBytes(buff, ((size > sizeof(buff)) ? sizeof(buff) : size));

                        // write it to Serial
                        //USE_SERIAL.write(buff, c);

                        if (len > 0) {
                            len -= c;
                        }

                        for (int i = 0; i < 128; i++) {
                            if ((buff[i] == 'M') && (buff[i + 1] == 'b') && (buff[i + 2] == 'p') && (buff[i + 3] == 's')) {
                                gotMbps = true;
                                int ite = 0;
                                int startChar = i;

                                while (1) {
                                    if (buff[startChar - ite] == '>') {
                                        startChar -= ite;
                                        break;
                                    }
                                    ite++;
                                }

                                Serial.print("StartChar: ");
                                Serial.println(startChar);
                                String throughput = "";

                                for (int x = startChar + 1; x < i; x++) {
                                    throughput += (char)buff[x];
                                }

                                Serial.print("Speed: ");
                                Serial.println(throughput);
                                float flSpeed = throughput.toInt();
                                flSpeed *= 1.28;
                                speed = flSpeed;
                                return speed;

                            }
                        }

                    }
                    delay(1);
                }

                //USE_SERIAL.println();
                //USE_SERIAL.print("[HTTP] connection closed or file end.\n");

            }
        }
        else {
            USE_SERIAL.printf("[HTTP] GET... failed, error: %s\n", http.errorToString(httpCode).c_str());
        }

        delay(1000);

        http.addHeader("Host", AP_LIFI_IP);
        http.addHeader("Connection", "keep-alive");
        http.addHeader("Content-Length", "17");
        http.addHeader("Content-Type", "application/x-www-form-urlencoded");    //Specify content-type header

        httpCode = http.POST(".PASSWORD=paterna");   //Send the request
        String payload = http.getString();    //Get the response payload

        Serial.println(httpCode);   //Print HTTP return code
        //Serial.println(payload);    //Print request response payload

        delay(100);
        if (!gotMbps) {
            getUplinkSpeed();
        }
    }

    return speed;
}

int getDownlinkSpeed() {

    int speed = 0;
    String EP_LIFI_IP = "http://192.168.1.20";

    if ((WiFiMulti.run() == WL_CONNECTED)) {

        HTTPClient http;

        USE_SERIAL.print("[HTTP] begin...\n");

        boolean gotMbps = false;

        // configure server and url
        http.begin(EP_LIFI_IP);
        //http.begin("192.168.1.12", 80, "/test.html");

        USE_SERIAL.print("[HTTP] GET...\n");
        // start connection and send HTTP header
        int httpCode = http.GET();
        if (httpCode > 0) {
            // HTTP header has been send and Server response header has been handled
            USE_SERIAL.printf("[HTTP] GET DOWNLINK code: %d\n", httpCode);

            // file found at server
            if (httpCode == HTTP_CODE_OK) {

                // get lenght of document (is -1 when Server sends no Content-Length header)
                int len = http.getSize();

                // create buffer for read
                uint8_t buff[128] = { 0 };

                // get tcp stream
                WiFiClient* stream = http.getStreamPtr();

                // read all data from server
                while (http.connected() && (len > 0 || len == -1)) {
                    // get available data size
                    size_t size = stream->available();

                    if (size) {
                        // read up to 128 byte
                        int c = stream->readBytes(buff, ((size > sizeof(buff)) ? sizeof(buff) : size));

                        // write it to Serial
                        //USE_SERIAL.write(buff, c);

                        if (len > 0) {
                            len -= c;
                        }

                        for (int i = 0; i < 128; i++) {
                            if ((buff[i] == 'M') && (buff[i + 1] == 'b') && (buff[i + 2] == 'p') && (buff[i + 3] == 's')) {
                                gotMbps = true;
                                int ite = 0;
                                int startChar = i;

                                while (1) {
                                    if (buff[startChar - ite] == '>') {
                                        startChar -= ite;
                                        break;
                                    }
                                    ite++;
                                }

                                Serial.print("StartChar: ");
                                Serial.println(startChar);
                                String throughput = "";

                                for (int x = startChar + 1; x < i; x++) {
                                    throughput += (char)buff[x];
                                }

                                Serial.print("Speed: ");
                                Serial.println(throughput);
                                float flSpeed = throughput.toInt();
                                flSpeed *= 1.28;
                                speed = flSpeed;

                            }
                        }

                    }
                    delay(1);
                }

                //USE_SERIAL.println();
                //USE_SERIAL.print("[HTTP] connection closed or file end.\n");

            }
        }
        else {
            USE_SERIAL.printf("[HTTP] GET... failed, error: %s\n", http.errorToString(httpCode).c_str());
        }

        delay(1000);

        http.addHeader("Host", EP_LIFI_IP);
        http.addHeader("Connection", "keep-alive");
        http.addHeader("Content-Length", "17");
        http.addHeader("Content-Type", "application/x-www-form-urlencoded");    //Specify content-type header

        httpCode = http.POST(".PASSWORD=paterna");   //Send the request
        String payload = http.getString();    //Get the response payload

        Serial.println(httpCode);   //Print HTTP return code
        //Serial.println(payload);    //Print request response payload

        delay(100);
        if (!gotMbps) {
            getUplinkSpeed();
        }
    }

    return speed;
}


/*
byte count = 0;
byte dir = 1;
byte flip = 0;
byte generation = 0;


unsigned int drawFrame() {

    for (byte x = 0; x < MATRIX_WIDTH; x++) {
        for (byte y = 0; y < MATRIX_HEIGHT; y++) {
            //effects.leds[XY(x, y)] = (x ^ y ^ flip) < count ? effects.ColorFromCurrentPalette(((x ^ y) << 2) + generation) : CRGB::Black;

            // The below is more pleasant
            effects.leds[XY(x, y)] = effects.ColorFromCurrentPalette(((x ^ y) << 2) + generation) ;
        }
    }

    count += dir;

    if (count <= 0 || count >= MATRIX_WIDTH) {
        dir = -dir;
    }

    if (count <= 0) {
        if (flip == 0)
            flip = MATRIX_WIDTH - 1;
        else
            flip = 0;
    }

    generation++;

    // show it ffs!
    effects.ShowFrame();

    return 60;
}

*/